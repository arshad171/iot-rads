
#include <TensorFlowLite.h>
#include "tensorflow/lite/micro/all_ops_resolver.h"
#include "tensorflow/lite/micro/micro_error_reporter.h"
#include "tensorflow/lite/micro/micro_interpreter.h"
#include "tensorflow/lite/schema/schema_generated.h"
#include "tensorflow/lite/version.h"


// Include the model data
#include "C:\Users\Blake\Desktop\Pics\model_int8_try.cpp"

const char* TensorTypeName(TfLiteType type) {
    switch (type) {
        case kTfLiteFloat32: return "Float32";
        case kTfLiteInt32:   return "Int32";
        case kTfLiteUInt8:   return "UInt8";
        case kTfLiteInt8:    return "Int8";
        case kTfLiteInt16:   return "Int16";
        case kTfLiteBool:    return "Bool";
        case kTfLiteFloat16: return "Float16";
        default:             return "Unknown";
    }
}

// Define a tensor arena with a size that's appropriate for your model and platform.
// You may need to adjust this size based on your model's requirements and your board's available memory.

constexpr int tensor_arena_size = 100 * 1024;  // Example size: 200 KB
uint8_t tensor_arena[tensor_arena_size];



tflite::MicroErrorReporter error_reporter;
tflite::AllOpsResolver resolver;
const tflite::Model* model = nullptr;
tflite::MicroInterpreter* interpreter = nullptr;
TfLiteTensor* input = nullptr;
TfLiteTensor* output = nullptr;

const int8_t imageData[] = {
115, 122, 108, -123, -117, -128, 107, 115, 113, 49, 53, 52,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 33
};



int8_t reshaped_data[1][240][320][1];




void setup() {
    // Initialize serial communication
    Serial.begin(9600);
    while (!Serial) {
        ; // Wait for serial port to connect
    }
    Serial.println("Serial communication started.");
    int myIndex = 0;
    for (int i = 0; i < 240; ++i) {
      for (int j = 0; j < 320; ++j) {
        for (int k = 0; k < 1; ++k) {
          reshaped_data[0][i][j][k] = imageData[myIndex++];
        }
    }
  }


    // Set up the model, interpreter, and tensors
    model = tflite::GetModel(model_data);
    if (model->version() != TFLITE_SCHEMA_VERSION) {
        Serial.println("Model schema version does not match TensorFlow Lite runtime.");
        return;
    }

    static tflite::MicroInterpreter static_interpreter(model, resolver, tensor_arena, tensor_arena_size, &error_reporter);
    interpreter = &static_interpreter;

    // Allocate memory from the tensor_arena for the model's tensors
    TfLiteStatus allocate_status = interpreter->AllocateTensors();
    if (interpreter->AllocateTensors() != kTfLiteOk) {
        Serial.println("Failed to allocate tensors!");
        return;
    }

    

    // Obtain pointers to the model's input and output tensors
    input = interpreter->input(0);
    Serial.print("Input tensor type: ");
    Serial.println(TensorTypeName(input->type));
    output = interpreter->output(0);

    Serial.println("Model loaded and tensors allocated yes.");
}

void loop() {
    // Assign the reshaped image data to the model's input tensor
    TfLiteTensor* input_tensor = interpreter->input(0);
    memcpy(input_tensor->data.int8, reshaped_data, sizeof(reshaped_data));


    


    // Run the model
    if (interpreter->Invoke() == kTfLiteOk) {
        Serial.println("Model invoked successfully.");

        // Get the output tensor
        TfLiteTensor* output_tensor = interpreter->output(0);

        // Ensure the output tensor size is as expected
        int output_length = output_tensor->bytes / sizeof(float);
        if (output_length == 100) {
            Serial.println("Feature vector:");
            for (int i = 0; i < output_length; i++) {
                Serial.print(output_tensor->data.f[i],5);
                if (i < output_length - 1) {
                    Serial.print(", ");
                }
            }
            Serial.println();
        } else {
            Serial.println("Unexpected output tensor size.");
        }
    } else {
        Serial.println("Failed to invoke the interpreter.");
    }

    // Add a delay to avoid continuous inference in the loop
    delay(100000);  // Example: 10-second delay

}
